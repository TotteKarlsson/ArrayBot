#pragma hdrstop
#include "atUtils.h"
#include <sstream>
#include "dslLogger.h"
//---------------------------------------------------------------------------

using namespace std;
using namespace dsl;

namespace at
{

string toString(LogicOperator o)
{
	switch(o)
    {
		case loLargerThan: 			return ">";
        case loSmallerThan:    		return "<";
        case loEqualTo:             return "=";
        case loLargerThanOrEqual:   return ">=";
        case loSmallerThanOrEqual:	return "<=";
        default: 					return "unknown";
    }
}

LogicOperator toLogicOperator(const string& o)
{
	if(o == ">")	return loLargerThan;
	if(o == "<")	return loSmallerThan;
	if(o == "=")	return loEqualTo;
   	if(o == ">=")	return loLargerThanOrEqual;
   	if(o == "<=")	return loSmallerThanOrEqual;

    return loUndefined;
}

string toString(ProcessType pt)
{
	switch(pt)
    {
    	case ptParallel: 		        return "parallelProcess";
    	case ptAbsoluteMove: 			return "absoluteMove";
    	case ptArduinoServerCommand: 	return "arduinoServerCommand";
    	case ptTimeDelay: 		        return "timeDelay";
    	case ptStopAndResume:		    return "stopAndResumeProcess";
    	case ptArrayCamRequest:			return "arrayCamRequestProcess";
    	case ptArrayBotRequest:			return "arrayBotRequestProcess";
    	case ptMoveCoverSlipAtAngle:   	return "liftAtAngleProcess";
    	case ptHomeMotor:   			return "homeMotor";
        default: 				        return "unknownProcessType";
    }
}


int extractCoverSlipID(const string& bc)
{
	string temp(bc);
    //Make sure first char is a 'C'
    if(!bc.size() || bc[0] != 'C')
    {
    	Log(lError) << bc << " is not a valid barcode!";
        return -1;
    }

	temp.erase(0,1);
    int id = toInt(temp);
    Log(lDebug3) << "Extracted id "<<id<<" from "<<bc;
    return id;
}


//enum ProcessType {ptBaseType = 0, ptMaster, ptParallel, ptAbsoluteMove, ptTimeDelay, ptUnknown};

ProcessType toProcessType(const string& str)
{
	if(str == "parallelProcess")
    {
    	return ptParallel;
    }

	if(str == "absoluteMove")
    {
    	return ptAbsoluteMove;
    }

  	if(str == "arduinoServerCommand")
    {
    	return ptArduinoServerCommand;
    }

	if(str == "timeDelay")
    {
    	return ptTimeDelay;
    }

	if(str == "stopAndResumeProcess")
    {
    	return ptStopAndResume;
    }

	if(str == "arrayCamRequestProcess")
    {
    	return ptArrayCamRequest;
    }

	if(str == "arrayBotRequestProcess")
    {
    	return ptArrayBotRequest;
    }

	if(str == "liftAtAngleProcess")
    {
    	return ptMoveCoverSlipAtAngle;
    }

	if(str == "homeMotor")
    {
    	return ptHomeMotor;
    }

	return ptUnknown;
}

string tlError(int err)
{
	stringstream str;
    str<<"Error nr="<<err<<": ";

	switch(err)
    {
        case 0: str << "FT_OK - Success";                                                                                                                           break;
        case 1: str << "FT_InvalidHandle - The FTDI functions have not been initialized.";                                                                          break;
        case 2: str << "FT_DeviceNotFound - The Device could not be found. \nThis can be generated if the function TLI_BuildDeviceList() has not been called.";     break;
        case 3: str << "FT_DeviceNotOpened - The Device must be opened before it can be accessed. See the appropriate Open function for your device.";              break;
        case 4: str << "FT_IOError - An I/O Error has occured in the FTDI chip.";                                                                                   break;
        case 5: str << "FT_InsufficientResources - There are Insufficient resources to run this application.";                                                      break;
        case 6: str << "FT_InvalidParameter - An invalid parameter has been supplied to the device.";                                                               break;
        case 7: str << "FT_DeviceNotPresent - The Device is no longer present. The device may have been disconnected since the last TLI_BuildDeviceList() call.";   break;
        case 8: str << "FT_IncorrectDevice - The device detected does not match that expected.";                                                                    break;

        // General DLL control errors<S-Del>
        //The following errors are general errors generated by all DLLs.
        case 32: str << "(0x20) TL_ALREADY_OPEN - Attempt to open a device that was already open.";                                                                 break;
        case 33: str << "(0x21) TL_NO_RESPONSE - The device has stopped responding.";                                                                               break;
        case 34: str << "(0x22) TL_NOT_IMPLEMENTED - This function has not been implemented.";                                                                      break;
        case 35: str << "(0x23) TL_FAULT_REPORTED - The device has reported a fault.";                                                                              break;
        case 36: str << "(0x24) TL_INVALID_OPERATION - The function could not be completed at this time.";                                                          break;
        case 40: str << "(0x28) TL_DISCONNECTING - The function could not be completed because the device is disconnected.";                                        break;
        case 41: str << "(0x29) TL_FIRMWARE_BUG - The firmware has thrown an error";                                                                                break;
        case 42: str << "(0x2A) TL_INITIALIZATION_FAILURE - The device has failed to initialize";                                                                   break;
        case 43: str << "(0x2B) TL_INVALID_CHANNEL - An Invalid channel address was supplied";                                                                      break;

        // Motor specific errors
        //The following errors are motor specific errors generated by the Motor DLLs.

        case 37:  str << "(0x25) TL_UNHOMED - The device cannot perform this function until it has been Homed.";                                                    break;
        case 38:  str << "(0x26) TL_INVALID_POSITION - The function cannot be performed as it would result in an illegal position.";                                break;
        case 39:  str << "(0x27) TL_INVALID_VELOCITY_PARAMETER - An invalid velocity parameter was supplied. The velocity must be greater than zero.";              break;
        case 44:  str << "(0x2C) TL_CANNOT_HOME_DEVICE - This device does not support Homing. Check the Limit switch parameters are correct.";                      break;
        case 45:  str << "(0x2D) TL_JOG_CONTINOUS_MODE - An invalid jog mode was supplied for the jog function.";                                                   break;
        default:  str<< "This error is not reckognized: "<<err;                                                                                                     break;
    }
    return str.str();
}

}
